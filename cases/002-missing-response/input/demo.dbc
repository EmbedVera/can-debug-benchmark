VERSION ""

NS_ :

BS_:

BU_: BCM HCM

BO_ 513 LIGHT_REQUEST: 8 BCM
 SG_ RequestCounter : 0|8@1+ (1,0) [0|255] "" HCM
 SG_ HighBeamRequest : 8|1@1+ (1,0) [0|1] "" HCM

BO_ 769 HCM_STATUS: 8 HCM
 SG_ ResponseCounter : 0|8@1+ (1,0) [0|255] "" BCM
 SG_ HighBeamActive : 8|1@1+ (1,0) [0|1] "" BCM
